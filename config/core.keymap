// Copyrighm (c) 2022 The ZMK Contributors
// SPDX-License-Identifier: MIT

#include "../zmk-nodefree-config/keypos_def/keypos_42keys.h"

#include <behaviors.dtsi>
#include <dt-bindings/zmk/keys.h>
#include <dt-bindings/zmk/bt.h>
#include <dt-bindings/zmk/mouse.h>

#include "includes/settings.dtsi"
#include "includes/behaviours_homerow_mods.dtsi"


#define CLMKL 0
#define FNL   1
#define NUML  2
#define NAVL  3
#define QWERT 4
#define SETL  5


// Home row mods macro
#define HRML(k1,k2,k3,k4) &hm_l LGUI k1  &hm_l LALT k2  &hm_l LCTRL k3  &hm_l LSHFT k4
#define HRMR(k1,k2,k3,k4) &hm_r RSHFT k1  &hm_r RCTRL k2  &hm_r RALT k3  &hm_r RGUI k4

#define ____________________TRANSPARENT_____________________ &trans      &trans      &trans      &trans      &trans
#define ________________________RALT________________________ &trans      &caps_word  &kp RCTRL   &kp RALT    &kp RGUI
#define ________________________LALT________________________ &kp LGUI    &kp LALT    &kp LCTRL   &caps_word  &trans


// COLEMAK LAYER
//╭──────────┬──────────┬──────────┬──────────┬──────────╮         ╭──────────┬──────────┬──────────┬──────────┬──────────╮
//│  Q       │  W       │  F       │  P       │  B       │         │  J       │  L       │  U       │  Y       │  ; :     │
//├──────────┼──────────┼──────────┼──────────┼──────────┤         ├──────────┼──────────┼──────────┼──────────┼──────────┤
//│  A       │  R       │  S       │  T       │  G       │         │  M       │  N       │  E       │  I       │  O       │
//├──────────┼──────────┼──────────┼──────────┼──────────┤         ├──────────┼──────────┼──────────┼──────────┼──────────┤
//│  Z       │  X       │  C       │  D       │  V       │         │  K       │  H       │  , <     │  . >     │ / ?      │
//╰──────────┴──────────┴──────────┼──────────┼──────────┤         ├──────────┼──────────┼──────────┴──────────┴──────────╯
//                                 │NAVL ENTER│NUML SPACE│         │ FNL BSPC │  LSHFT   │
//                                 ╰──────────┴──────────╯         ╰──────────┴──────────╯

#define _____________________COLEMAK_L1_____________________ &kp Q       &kp W       &kp F       &kp P       &kp B
#define _____________________COLEMAK_R1_____________________ &kp J       &kp L       &kp U       &kp Y       &kp SEMI
#define _____________________COLEMAK_L2_____________________ HRML(A,     R,          S,          T)          &kp G
#define _____________________COLEMAK_R2_____________________ &kp M       HRMR(N,     E,          I,          O)
#define _____________________COLEMAK_L3_____________________ &kp Z       &kp X       &kp C       &kp D       &kp V
#define _____________________COLEMAK_R3_____________________ &kp K       &kp H       &kp COMMA   &kp DOT     &kp FSLH
#define _____________________COLEMAK_L4_____________________ &lt NAVL ENTER   &lt NUML SPACE
#define _____________________COLEMAK_R4_____________________ &lt FNL BSPC     &kp LSHFT


// FN LAYER
//╭──────────┬──────────┬──────────┬──────────┬──────────╮         ╭──────────┬──────────┬──────────┬──────────┬──────────╮
//│  ESCAPE  │  F7      │  F8      │  F9      │  F12     │         │          │          │          │          │          │
//├──────────┼──────────┼──────────┼──────────┼──────────┤         ├──────────┼──────────┼──────────┼──────────┼──────────┤
//│  CAPS    │  F4      │  F5      │  F6      │  F11     │         │          │          │          │          │          │
//├──────────┼──────────┼──────────┼──────────┼──────────┤         ├──────────┼──────────┼──────────┼──────────┼──────────┤
//|          │  F1      │  F2      │  F3      │  F10     │         │  mouse4  │  mouse1  │  mouse2  │  mouse3  │  mouse5  │
//╰──────────┴──────────┴──────────┼──────────┼──────────┤         ├──────────┼──────────┼──────────┴──────────┴──────────╯
//                                 │          │          │         │          │          │
//                                 ╰──────────┴──────────╯         ╰──────────┴──────────╯

#define ________________________FN_L1_______________________ &kp ESC     &kp F7      &kp F8      &kp F9      &kp F12
#define ________________________FN_R1_______________________ ____________________TRANSPARENT_____________________
#define ________________________FN_L2_______________________ &kp CAPS    &kp F4      &kp F5      &kp F6      &kp F11
#define ________________________FN_R2_______________________ ________________________RALT________________________
#define ________________________FN_L3_______________________ &trans      &kp F1      &kp F2      &kp F3      &kp F10
#define ________________________FN_R3_______________________ &mkp MB4    &mkp MB1    &mkp MB2    &mkp MB3    &mkp MB5
#define ________________________FN_L4_______________________ &trans      &trans
#define ________________________FN_R4_______________________ &trans      &trans


// NUM LAYER
//╭──────────┬──────────┬──────────┬──────────┬──────────╮        ╭──────────┬──────────┬──────────┬──────────┬──────────╮
//│  (       │  )       │  [       │  ]       │   TAB    │        │  -       │  7       │  8       │  9       │  \ |     │
//├──────────┼──────────┼──────────┼──────────┼──────────┤        ├──────────┼──────────┼──────────┼──────────┼──────────┤
//│          │          │          │          │          │        │  = +     │  4       │  5       │  6       │  '       │
//├──────────┼──────────┼──────────┼──────────┼──────────┤        ├──────────┼──────────┼──────────┼──────────┼──────────┤
//│  ESCAPE  │          │          │          │  `       │        │  0       │  1       │  2       │  3       │  -       │
//╰──────────┴──────────┴──────────┼──────────┼──────────┤        ├──────────┼──────────┼──────────┴──────────┴──────────╯
//                                 │          │          │        │  DEL     │          │
//                                 ╰──────────┴──────────╯        ╰──────────┴──────────╯

#define _______________________NUM_L1_______________________ &kp LPAR    &kp RPAR    &kp LBKT    &kp RBKT    &kp TAB
#define _______________________NUM_R1_______________________ &kp MINUS   &kp N7      &kp N8      &kp N9      &kp BSLH
#define _______________________NUM_L2_______________________ ________________________LALT________________________
#define _______________________NUM_R2_______________________ &kp EQUAL   &kp N4      &kp N5      &kp N6      &kp SQT
#define _______________________NUM_L3_______________________ &kp ESC     &trans      &trans      &trans      &kp GRAVE
#define _______________________NUM_R3_______________________ &kp N0      &kp N1      &kp N2      &kp N3      &kp MINUS
#define _______________________NUM_L4_______________________ &trans      &trans
#define _______________________NUM_R4_______________________ &kp DEL     &trans


// NAV LAYER
//╭──────────┬──────────┬──────────┬──────────┬──────────╮        ╭──────────┬──────────┬──────────┬──────────┬──────────╮
//│  (       │  )       │  [       │  ]       │   TAB    │        │  INSERT  │  PREV    │  PLAY    │  NEXT    │  VOL UP  │
//├──────────┼──────────┼──────────┼──────────┼──────────┤        ├──────────┼──────────┼──────────┼──────────┼──────────┤
//│          │          │          │          │          │        │  LEFT    │  DOWN    │  UP      │  RIGHT   │  VOL DOWN│
//├──────────┼──────────┼──────────┼──────────┼──────────┤        ├──────────┼──────────┼──────────┼──────────┼──────────┤
//│  ESCAPE  │          │          │          │  `       │        │  HOME    │  PGDN    │  PGUP    │  END     │  MUTE    │
//╰──────────┴──────────┴──────────┼──────────┼──────────┤        ├──────────┼──────────┼──────────┴──────────┴──────────╯
//                                 │          │          │        │  DEL     │          │
//                                 ╰──────────┴──────────╯        ╰──────────┴──────────╯

#define _______________________NAV_L1_______________________ &kp LPAR    &kp RPAR    &kp LBKT    &kp RBKT    &kp TAB
#define _______________________NAV_R1_______________________ &kp INS     &kp C_PREV  &kp C_PP    &kp C_NEXT  &kp C_VOL_UP
#define _______________________NAV_L2_______________________ ________________________LALT________________________
#define _______________________NAV_R2_______________________ &kp LEFT    &kp DOWN    &kp UP      &kp RIGHT   &kp C_VOL_DN
#define _______________________NAV_L3_______________________ &kp ESC     &trans      &trans      &trans      &kp GRAVE
#define _______________________NAV_R3_______________________ &kp HOME    &kp PG_DN   &kp PG_UP   &kp END     &kp C_MUTE
#define _______________________NAV_L4_______________________ &trans      &trans
#define _______________________NAV_R4_______________________ &kp DEL     &trans

// QWERTY LAYER
//╭──────────┬──────────┬──────────┬──────────┬──────────╮         ╭──────────┬──────────┬──────────┬──────────┬──────────╮
//│  Q       │  W       │  E       │  R       │  T       │         │  Y       │  U       │  I       │  O       │  P       │
//├──────────┼──────────┼──────────┼──────────┼──────────┤         ├──────────┼──────────┼──────────┼──────────┼──────────┤
//│  A       │  S       │  D       │  F       │  G       │         │  H       │  J       │  K       │  L       │  ; :     │
//├──────────┼──────────┼──────────┼──────────┼──────────┤         ├──────────┼──────────┼──────────┼──────────┼──────────┤
//│  Z       │  X       │  C       │  V       │  B       │         │  N       │  M       │  , <     │  . >     │ / ?      │
//╰──────────┴──────────┴──────────┼──────────┼──────────┤         ├──────────┼──────────┼──────────┴──────────┴──────────╯
//                                 │NAVL ENTER│NUML SPACE│         │ FNL BSPC │ LSHFT    │
//                                 ╰──────────┴──────────╯         ╰──────────┴──────────╯


#define ______________________QWERTY_L1_____________________ &kp Q       &kp W       &kp E       &kp R       &kp T
#define ______________________QWERTY_R1_____________________ &kp Y       &kp U       &kp I       &kp O       &kp P
#define ______________________QWERTY_L2_____________________ HRML(A,     S,          D,          F)          &kp G
#define ______________________QWERTY_R2_____________________ &kp H       HRMR(J,     K,          L,          SEMI)
#define ______________________QWERTY_L3_____________________ &kp Z       &kp X       &kp C       &kp V       &kp B
#define ______________________QWERTY_R3_____________________ &kp N       &kp M       &kp COMMA   &kp DOT     &kp FSLH
#define ______________________QWERTY_L4_____________________ &lt NAVL ENTER   &lt NUML SPACE
#define ______________________QWERTY_R4_____________________ &lt FNL BSPC     &kp LSHFT


// SETTINGS LAYER
//╭──────────┬──────────┬──────────┬──────────┬──────────╮        ╭──────────┬──────────┬──────────┬──────────┬──────────╮
//│  RESET   │          │          │          │PROFILE 0 │        │          │          │          │          │  RESET   │
//├──────────┼──────────┼──────────┼──────────┼──────────┤        ├──────────┼──────────┼──────────┼──────────┼──────────┤
//│BOOTLOADER│          │          │          │PROFILE 1 │        │          │          │          │          │BOOTLOADER│
//├──────────┼──────────┼──────────┼──────────┼──────────┤        ├──────────┼──────────┼──────────┼──────────┼──────────┤
//│          │          │          │ CLEAR BT │PROFILE 2 │        │          │          │          │          │          │
//╰──────────┴──────────┴──────────┼──────────┼──────────┤        ├──────────┼──────────┼──────────┴──────────┴──────────╯
//                                 │          │          │        │          │          │
//                                 ╰──────────┴──────────╯        ╰──────────┴──────────╯

#define _______________________SET_L1_______________________ &sys_reset  &trans      &kp TILDE   &trans      &bt BT_SEL 0
#define _______________________SET_R1_______________________ &trans      &trans      &trans      &trans      &sys_reset
#define _______________________SET_L2_______________________ &bootloader &trans      &trans      &trans      &bt BT_SEL 1
#define _______________________SET_R2_______________________ &trans      &trans      &trans      &trans      &bootloader
#define _______________________SET_L3_______________________ &to CLMKL   &to QWERT   &trans      &bt BT_CLR  &bt BT_SEL 2
#define _______________________SET_R3_______________________ ____________________TRANSPARENT_____________________
#define _______________________SET_L4_______________________ &trans      &trans
#define _______________________SET_R4_______________________ &trans      &trans
